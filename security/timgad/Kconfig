## security/timgad/Kconfig
```kconfig
config SECURITY_TIMGAD
	bool "TIMGAD support"
	depends on SECURITY
	default n
	help
	  This selects TIMGAD, which applies restrictions on load and unload
          modules operations. Further information can be found in
          Documentation/security/Timgad.txt.

	  If you are unsure how to answer this question, answer N.
```
